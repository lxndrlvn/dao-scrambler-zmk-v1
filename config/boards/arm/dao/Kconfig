## config/boards/arm/dao/Kconfig
```kconfig
# Copyright (c) 2021 Rafael Yumagulov
# SPDX-License-Identifier: MIT

ONFIG_ZMK_IDLE_TIMEOUT=90000
CONFIG_ZMK_SLEEP=y
CONFIG_ZMK_IDLE_SLEEP_TIMEOUT=2700000

config BOARD_ENABLE_DCDC
	bool "Enable DCDC mode"
	select SOC_DCDC_NRF52X
	default y
	depends on (BOARD_DAO_LEFT || BOARD_DAO_RIGHT)
```
